## sdkconfig.defaults
```kconfig
# Enable FreeRTOS stats for debugging
CONFIG_FREERTOS_USE_STATS_FORMATTING_FUNCTIONS=y
CONFIG_FREERTOS_GENERATE_RUN_TIME_STATS=y

# Enable core dump
CONFIG_ESP_COREDUMP_ENABLE_TO_FLASH=y

# Task watchdog
CONFIG_ESP_TASK_WDT=y
CONFIG_ESP_TASK_WDT_TIMEOUT_S=5
CONFIG_ESP_TASK_WDT_PANIC=y

# Log level
CONFIG_LOG_DEFAULT_LEVEL_INFO=y

# FreeRTOS tick rate
CONFIG_FREERTOS_HZ=1000

# Enable LEDC fade support (optional)
CONFIG_LEDC_CTRL_FUNC_IN_IRAM=y
```
